/*
 * Device Tree Source for the r8a7373 based amethyst board
 *
 * Copyright (C) 2013 Renesas Mobile
 *
 * This file is licensed under the terms of the GNU General Public License
 * version 2.  This program is licensed "as is" without any warranty of any
 * kind, whether express or implied.
 */

/dts-v1/;

#ifdef SECURE_CARVEOUT	// Allow secure variant to insert memreserve, normally do nothing.
SECURE_CARVEOUT
#endif
#include "r8a7373.dtsi"
#include "amethyst.dtsi"

/{
	model = "U2 Amethyst";
	compatible = "renesas,amethyst,r8a7373", "renesas,amethyst", "renesas,r8a7373";
};
